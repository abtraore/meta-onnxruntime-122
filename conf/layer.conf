## conf/layer.conf
```bitbake
# We have a conf and classes directory, add to BBPATH
BBPATH .= ":${LAYERDIR}"

# We have recipes-* directories, add to BBFILES
BBFILES += "${LAYERDIR}/recipes-*/*/*.bb \
            ${LAYERDIR}/recipes-*/*/*.bbappend"

BBFILE_COLLECTIONS += "meta-onnxruntime-122"
BBFILE_PATTERN_meta-onnxruntime-122 = "^${LAYERDIR}/"
BBFILE_PRIORITY_meta-onnxruntime-122 = "10"

LAYERDEPENDS_meta-onnxruntime-122 = "core"
LAYERSERIES_COMPAT_meta-onnxruntime-122 = "scarthgap"
LAYERVERSION_meta-onnxruntime-122 = "1"
```
